/*
** ###################################################################
**
**     THIS BEAN MODULE IS GENERATED BY THE TOOL. DO NOT MODIFY IT.
**
**     Filename  : Seleccion.C
**
**     Project   : CtrlCam
** 
**     Processor : MC68HC908GP32CFB
**
**     Beantype  : BitsIO
**
**     Version   : Bean 02.022, Driver 02.16, CPU db: 2.89.000
**
**     Compiler  : Metrowerks HC08 C Compiler
**
**     Date/Time : 9/15/miИrcoles, 10:49
**
**     Abstract  :
**
**         This bean "BitsIO" implements a multi-bit input/output.
**         It uses selected pins of one 1-bit to 8-bit port.
**         Note: This bean is set to work in Output direction only.
**
**     Settings  :
**
**         Port name                   : PTD
**
**         Bit mask of the port        : 15
**         Number of bits/pins         : 4
**         Single bit numbers          : 0 to 3
**         Values range                : 0 to 15
**
**         Initial direction           : Output (direction cannot be changed)
**         Initial output value        : 0 = 000H
**         Initial pull option         : off
**
**         Port data register          : PTD       [3]
**         Port control register       : DDRD      [7]
**         Port function register      : SPCR      [16]
**
**             ----------------------------------------------------
**                   Bit     |   Pin   |   Name
**             ----------------------------------------------------
**                    0      |    12   |   PTD0_SS
**                    1      |    13   |   PTD1_MISO
**                    2      |    14   |   PTD2_MOSI
**                    3      |    15   |   PTD3_SPSCK
**             ----------------------------------------------------
**
**         Optimization for            : speed
**
**     Contents  :
**
**         GetDir - bool Seleccion_GetDir(void);
**         GetVal - byte Seleccion_GetVal(void);
**         PutVal - void Seleccion_PutVal(byte Val);
**         GetBit - bool Seleccion_GetBit(byte Bit);
**         PutBit - void Seleccion_PutBit(byte Bit,bool Val);
**         SetBit - void Seleccion_SetBit(byte Bit);
**         ClrBit - void Seleccion_ClrBit(byte Bit);
**         NegBit - void Seleccion_NegBit(byte Bit);
**
**
**     (c) Copyright UNIS, spol. s r.o. 1997-2002
**
**     UNIS, spol. s r.o.
**     Jundrovska 33
**     624 00 Brno
**     Czech Republic
**
**     http      : www.processorexpert.com
**     mail      : info@processorexpert.com
**
** ###################################################################
*/

#include "Seleccion.h"

/*Include shared modules, which are used for whole project*/
#include "PE_Types.h"
#include "PE_Error.h"
#include "PE_Const.h"
#include "IO_Map.h"
#include "Cpu.h"

const byte Seleccion_Table[8]={ 1, 2, 4, 8, 16, 32, 64, 128 }; /* Table of mask constants */
/*
** ===================================================================
**     Method      :  Seleccion_GetMsk (bean BitsIO)
**
**     Description :
**         This method is internal. It is used by Processor Expert
**         only.
** ===================================================================
*/
byte Seleccion_GetMsk(byte Value)
{
  return((Value<4)?Seleccion_Table[Value]:0); /* Return appropriate bit mask */
}

/*
** ===================================================================
**     Method      :  Seleccion_GetVal (bean BitsIO)
**
**     Description :
**         This method returns an input value.
**           a) direction = Input  : reads the input value from the
**                                   pins and returns it
**           b) direction = Output : returns the last written value
**         Note: This bean is set to work in Output direction only.
**     Parameters  : None
**     Returns     :
**         ---        - Input value (0 to 15)
** ===================================================================
*/
/*
byte Seleccion_GetVal(void)

**  This method is implemented as a macro. See Seleccion.h file.  **
*/

/*
** ===================================================================
**     Method      :  Seleccion_PutVal (bean BitsIO)
**
**     Description :
**         This method writes the new output value.
**     Parameters  :
**         NAME       - DESCRIPTION
**         Value      - Output value (0 to 15)
**     Returns     : Nothing
** ===================================================================
*/
void Seleccion_PutVal(byte Value)
{
  PTD = (PTD & ~15) | (Value & 15);    /* Set-up bits on port */
}

/*
** ===================================================================
**     Method      :  Seleccion_GetBit (bean BitsIO)
**
**     Description :
**         This method returns the specified bit of the input value.
**           a) direction = Input  : reads the input value from pins
**                                   and returns the specified bit
**           b) direction = Output : returns the specified bit
**                                   of the last written value
**         Note: This bean is set to work in Output direction only.
**     Parameters  :
**         NAME       - DESCRIPTION
**         BitNum     - Number of the bit to read (0 to 3)
**     Returns     :
**         ---        - Value of the specified bit (FALSE or TRUE)
**                      FALSE = "0" or "Low", TRUE = "1" or "High"
** ===================================================================
*/
bool Seleccion_GetBit(byte BitNum)
{
  byte Mask=Seleccion_GetMsk(BitNum);  /* Temporary variable - bit mask */

  return((Mask)?(PTD & Mask) == Mask:0); /* Return input value */
}

/*
** ===================================================================
**     Method      :  Seleccion_PutBit (bean BitsIO)
**
**     Description :
**         This method writes the new value to the specified bit
**         of the output value.
**     Parameters  :
**         NAME       - DESCRIPTION
**         BitNum     - Number of the bit (0 to 3)
**         Value      - New value of the bit (FALSE or TRUE)
**                      FALSE = "0" or "Low", TRUE = "1" or "High"
**     Returns     : Nothing
** ===================================================================
*/
void Seleccion_PutBit(byte BitNum, byte Value)
{
  byte Mask=Seleccion_GetMsk(BitNum);  /* Temporary variable - bit mask */

  if (Mask)  {                         /* Is bit mask correct? */
    if (Value) {                       /* Is it one to be written? */
      PTD |= Mask;                     /* Set appropriate bit on port */
    }
    else {                             /* Is it zero to be written? */
      PTD &= ~Mask;                    /* Clear appropriate bit on port */
    }
  }
}

/*
** ===================================================================
**     Method      :  Seleccion_SetBit (bean BitsIO)
**
**     Description :
**         This method sets (sets to one) the specified bit of the
**         output value.
**         [ It is the same as "PutBit(Bit,TRUE);" ]
**     Parameters  :
**         NAME       - DESCRIPTION
**         BitNum     - Number of the bit to set (0 to 3)
**     Returns     : Nothing
** ===================================================================
*/
void Seleccion_SetBit(byte BitNum)
{
  byte Mask=Seleccion_GetMsk(BitNum);  /* Temporary variable - bit mask */

  if (Mask) {                          /* Is bit mask correct? */
    PTD |= Mask;                       /* Set appropriate bit on port */
  }
}

/*
** ===================================================================
**     Method      :  Seleccion_ClrBit (bean BitsIO)
**
**     Description :
**         This method clears (sets to zero) the specified bit
**         of the output value.
**         [ It is the same as "PutBit(Bit,FALSE);" ]
**     Parameters  :
**         NAME       - DESCRIPTION
**         BitNum     - Number of the bit to clear (0 to 3)
**     Returns     : Nothing
** ===================================================================
*/
void Seleccion_ClrBit(byte BitNum)
{
  byte Mask=Seleccion_GetMsk(BitNum);  /* Temporary variable - bit mask */

  if (Mask) {                          /* Is bit mask correct? */
    PTD &= ~Mask;                      /* Clear appropriate bit on port */
  }
}

/*
** ===================================================================
**     Method      :  Seleccion_NegBit (bean BitsIO)
**
**     Description :
**         This method negates (invertes) the specified bit of the
**         output value.
**     Parameters  :
**         NAME       - DESCRIPTION
**         BitNum     - Number of the bit to invert (0 to 31)
**     Returns     : Nothing
** ===================================================================
*/
void Seleccion_NegBit(byte BitNum)
{
  byte Mask=Seleccion_GetMsk(BitNum);  /* Temporary variable - bit mask */

  if (Mask) {                          /* Is bit mask correct? */
    PTD ^= Mask;                       /* Negate appropriate bit on port */
  }
}

/*
** ===================================================================
**     Method      :  Seleccion_GetDir (bean BitsIO)
**
**     Description :
**         This method returns direction of the bean.
**     Parameters  : None
**     Returns     :
**         ---        - Direction of the bean (always TRUE, Output only)
**                      FALSE = Input, TRUE = Output
** ===================================================================
*/
/*
bool Seleccion_GetDir(void)

**  This method is implemented as a macro. See Seleccion.h file.  **
*/

/*
** ###################################################################
**
**     This file was created by UNIS Processor Expert 03.23 for 
**     the Motorola HC08 series of microcontrollers.
**
** ###################################################################
*/
