/*
** ###################################################################
**
**     THIS BEAN MODULE IS GENERATED BY THE TOOL. DO NOT MODIFY IT.
**
**     Filename  : Timer.C
**
**     Project   : CtrlCam
** 
**     Processor : MC68HC908GP32CFB
**
**     Beantype  : TimerInt
**
**     Version   : Bean 02.059, Driver 01.16, CPU db: 2.89.000
**
**     Compiler  : Metrowerks HC08 C Compiler
**
**     Date/Time : 9/15/miИrcoles, 10:49
**
**     Abstract  :
**
**         This bean "TimerInt" implements a periodic interrupt.
**         When the bean and its events are enabled, the "OnInterrupt"
**         event is called periodically with the period that you specify.
**         TimerInt supports also changing the period in runtime.
**         The source of periodic interrupt can be timer compare or reload 
**         register or timer-overflow interrupt (of free running counter).
**
**     Settings  :
**
**         Timer name                  : TIM1 (16-bit)
**         Compare name                : TIM10
**         Counter shared              : No
**
**         High-speed CPU mode
**             Prescaler               : divide-by-64
**             Clock                   : 76800 Hz
**           Initial period/frequency
**             Xtal ticks              : 16384
**             microseconds            : 500000
**             milliseconds            : 500
**             seconds                 : 1
**             seconds (real)          : 0.5000000
**             Hz                      : 2
**
**         Runtime setting             : none
**
**         Initialization:
**              Timer                  : Enabled
**              Events                 : Enabled
**
**         Timer registers
**              Counter                : T1CNT     [33]
**              Mode                   : T1SC      [32]
**              Run                    : T1SC      [32]
**              Prescaler              : T1SC      [32]
**
**         Compare registers
**              Compare                : T1CH0     [38]
**
**         Flip-flop registers
**              Mode                   : T1SC0     [37]
**
**     Contents  :
**
**         Enable  - byte Timer_Enable(void);
**         Disable - byte Timer_Disable(void);
**
**
**     (c) Copyright UNIS, spol. s r.o. 1997-2002
**
**     UNIS, spol. s r.o.
**     Jundrovska 33
**     624 00 Brno
**     Czech Republic
**
**     http      : www.processorexpert.com
**     mail      : info@processorexpert.com
**
** ###################################################################
*/


/* MODULE Timer. */

#include "Events.h"
#include "PE_Error.h"
#include "Timer.h"

#pragma MESSAGE DISABLE C2705          /* WARNING C2705: Possible loss of data */
#pragma MESSAGE DISABLE C5919          /* WARNING C5919: Conversion of floating to unsigned integral */

static bool EnUser;                    /* Enable/Disable device by user */


/*
** ===================================================================
**     Method      :  SetCV (bean TimerInt)
**
**     Description :
**         This method is internal. It is used by Processor Expert
**         only.
** ===================================================================
*/
static void SetCV(word Val)
{
  T1CH0H = (*(TWREG*)&Val).b.high;     /* Store given value to the compare register */
  T1MODH = (*(TWREG*)&Val).b.high;     /* and to the modulo register */
  T1CH0L = (*(TWREG*)&Val).b.low;
  T1MODL = (*(TWREG*)&Val).b.low;
}

/*
** ===================================================================
**     Method      :  SetPV (bean TimerInt)
**
**     Description :
**         This method is internal. It is used by Processor Expert
**         only.
** ===================================================================
*/
static void SetPV(byte Val)
{
  T1SC_PS = Val;                       /* Store given value to the prescaler */
  T1SC_TRST = 1;                       /* Reset counter */
}

/*
** ===================================================================
**     Method      :  HWEnDi (bean TimerInt)
**
**     Description :
**         This method is internal. It is used by Processor Expert
**         only.
** ===================================================================
*/
static void HWEnDi(void)
{
  if (EnUser) {                        /* Enable device? */
    T1SC_TSTOP = 0;                    /* Run counter */
  }
  else {                               /* Disable device? */
    T1SC_TSTOP = 1;                    /* Stop counter */
    T1SC_TRST = 1;                     /* Reset counter */
  }
}

/*
** ===================================================================
**     Method      :  Timer_Enable (bean TimerInt)
**
**     Description :
**         Enable the bean - it starts the timer. Events may be
**         generated ("DisableEvent"/"EnableEvent").
**     Parameters  : None
**     Returns     :
**         ---             - Error code, possible codes:
**                           ERR_OK - OK
**                           ERR_SPEED - This device does not work in
**                           the active speed mode
** ===================================================================
*/
byte Timer_Enable(void)
{
  if (!EnUser) {                       /* Is the device disabled by user? */
    EnUser = TRUE;                     /* If yes then set the flag "device enabled" */
    HWEnDi();                          /* Enable the device */
  }
  return ERR_OK;                       /* OK */
}

/*
** ===================================================================
**     Method      :  Timer_Disable (bean TimerInt)
**
**     Description :
**         Disable the bean - it stops the timer. No events will be
**         generated.
**     Parameters  : None
**     Returns     :
**         ---             - Error code, possible codes:
**                           ERR_OK - OK
**                           ERR_SPEED - This device does not work in
**                           the active speed mode
** ===================================================================
*/
byte Timer_Disable(void)
{
  if (EnUser) {                        /* Is the device enabled by user? */
    EnUser = FALSE;                    /* If yes then set the flag "device disabled" */
    HWEnDi();                          /* Disable the device */
  }
  return ERR_OK;                       /* OK */
}

/*
** ===================================================================
**     Method      :  Timer_Init (bean TimerInt)
**
**     Description :
**         This method is internal. It is used by Processor Expert
**         only.
** ===================================================================
*/
void Timer_Init(void)
{
  /* T1SC: TOF=0,TOIE=0,TSTOP=1,TRST=1,??=0,PS2=0,PS1=0,PS0=0 */
  T1SC = 48;                           /* Set up (output) compare mode */
  /* T1SC0: CH0F=0,CH0IE=1,MS0B=0,MS0A=1,ELS0B=0,ELS0A=0,TOV0=0,CH0MAX=0 */
  T1SC0 = 80;
  EnUser = TRUE;                       /* Enable device */
  SetCV(38400);                        /* Store appropriate value to the compare register according to the selected high speed CPU mode */
  SetPV(6);                            /* Set prescaler register according to the selected high speed CPU mode */
  HWEnDi();                            /* Enable/disable device according to status flags */
}

/*
** ===================================================================
**     Method      :  Timer_Interrupt (bean TimerInt)
**
**     Description :
**         This method is internal. It is used by Processor Expert
**         only.
** ===================================================================
*/
__interrupt void Timer_Interrupt(void)
{
  T1SC0_CHxF = 0;                      /* Reset interrupt request flag */
  Timer_OnInterrupt();                 /* Invoke user event */
}


/* END Timer. */

/*
** ###################################################################
**
**     This file was created by UNIS Processor Expert 03.23 for 
**     the Motorola HC08 series of microcontrollers.
**
** ###################################################################
*/
