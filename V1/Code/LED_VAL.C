/*
** ###################################################################
**
**     THIS BEAN MODULE IS GENERATED BY THE TOOL. DO NOT MODIFY IT.
**
**     Filename  : LED_VAL.C
**
**     Project   : CtrlCam
** 
**     Processor : MC68HC908GP32CFB
**
**     Beantype  : BitsIO
**
**     Version   : Bean 02.022, Driver 02.16, CPU db: 2.89.000
**
**     Compiler  : Metrowerks HC08 C Compiler
**
**     Date/Time : 9/15/miИrcoles, 10:49
**
**     Abstract  :
**
**         This bean "BitsIO" implements a multi-bit input/output.
**         It uses selected pins of one 1-bit to 8-bit port.
**         Note: This bean is set to work in Output direction only.
**
**     Settings  :
**
**         Port name                   : PTC
**
**         Bit mask of the port        : 15
**         Number of bits/pins         : 4
**         Single bit numbers          : 0 to 3
**         Values range                : 0 to 15
**
**         Initial direction           : Output (direction cannot be changed)
**         Initial output value        : 0 = 000H
**         Initial pull option         : off
**
**         Port data register          : PTC       [2]
**         Port control register       : DDRC      [6]
**
**             ----------------------------------------------------
**                   Bit     |   Pin   |   Name
**             ----------------------------------------------------
**                    0      |    2    |   PTC0
**                    1      |    3    |   PTC1
**                    2      |    4    |   PTC2
**                    3      |    5    |   PTC3
**             ----------------------------------------------------
**
**         Optimization for            : speed
**
**     Contents  :
**
**         GetDir - bool LED_VAL_GetDir(void);
**         GetVal - byte LED_VAL_GetVal(void);
**         PutVal - void LED_VAL_PutVal(byte Val);
**         GetBit - bool LED_VAL_GetBit(byte Bit);
**         PutBit - void LED_VAL_PutBit(byte Bit,bool Val);
**         SetBit - void LED_VAL_SetBit(byte Bit);
**         ClrBit - void LED_VAL_ClrBit(byte Bit);
**         NegBit - void LED_VAL_NegBit(byte Bit);
**
**
**     (c) Copyright UNIS, spol. s r.o. 1997-2002
**
**     UNIS, spol. s r.o.
**     Jundrovska 33
**     624 00 Brno
**     Czech Republic
**
**     http      : www.processorexpert.com
**     mail      : info@processorexpert.com
**
** ###################################################################
*/

#include "LED_VAL.h"

/*Include shared modules, which are used for whole project*/
#include "PE_Types.h"
#include "PE_Error.h"
#include "PE_Const.h"
#include "IO_Map.h"
#include "Cpu.h"

const byte LED_VAL_Table[8]={ 1, 2, 4, 8, 16, 32, 64, 128 }; /* Table of mask constants */
/*
** ===================================================================
**     Method      :  LED_VAL_GetMsk (bean BitsIO)
**
**     Description :
**         This method is internal. It is used by Processor Expert
**         only.
** ===================================================================
*/
byte LED_VAL_GetMsk(byte Value)
{
  return((Value<4)?LED_VAL_Table[Value]:0); /* Return appropriate bit mask */
}

/*
** ===================================================================
**     Method      :  LED_VAL_GetVal (bean BitsIO)
**
**     Description :
**         This method returns an input value.
**           a) direction = Input  : reads the input value from the
**                                   pins and returns it
**           b) direction = Output : returns the last written value
**         Note: This bean is set to work in Output direction only.
**     Parameters  : None
**     Returns     :
**         ---        - Input value (0 to 15)
** ===================================================================
*/
/*
byte LED_VAL_GetVal(void)

**  This method is implemented as a macro. See LED_VAL.h file.  **
*/

/*
** ===================================================================
**     Method      :  LED_VAL_PutVal (bean BitsIO)
**
**     Description :
**         This method writes the new output value.
**     Parameters  :
**         NAME       - DESCRIPTION
**         Value      - Output value (0 to 15)
**     Returns     : Nothing
** ===================================================================
*/
void LED_VAL_PutVal(byte Value)
{
  PTC = (PTC & ~15) | (Value & 15);    /* Set-up bits on port */
}

/*
** ===================================================================
**     Method      :  LED_VAL_GetBit (bean BitsIO)
**
**     Description :
**         This method returns the specified bit of the input value.
**           a) direction = Input  : reads the input value from pins
**                                   and returns the specified bit
**           b) direction = Output : returns the specified bit
**                                   of the last written value
**         Note: This bean is set to work in Output direction only.
**     Parameters  :
**         NAME       - DESCRIPTION
**         BitNum     - Number of the bit to read (0 to 3)
**     Returns     :
**         ---        - Value of the specified bit (FALSE or TRUE)
**                      FALSE = "0" or "Low", TRUE = "1" or "High"
** ===================================================================
*/
bool LED_VAL_GetBit(byte BitNum)
{
  byte Mask=LED_VAL_GetMsk(BitNum);    /* Temporary variable - bit mask */

  return((Mask)?(PTC & Mask) == Mask:0); /* Return input value */
}

/*
** ===================================================================
**     Method      :  LED_VAL_PutBit (bean BitsIO)
**
**     Description :
**         This method writes the new value to the specified bit
**         of the output value.
**     Parameters  :
**         NAME       - DESCRIPTION
**         BitNum     - Number of the bit (0 to 3)
**         Value      - New value of the bit (FALSE or TRUE)
**                      FALSE = "0" or "Low", TRUE = "1" or "High"
**     Returns     : Nothing
** ===================================================================
*/
void LED_VAL_PutBit(byte BitNum, byte Value)
{
  byte Mask=LED_VAL_GetMsk(BitNum);    /* Temporary variable - bit mask */

  if (Mask)  {                         /* Is bit mask correct? */
    if (Value) {                       /* Is it one to be written? */
      PTC |= Mask;                     /* Set appropriate bit on port */
    }
    else {                             /* Is it zero to be written? */
      PTC &= ~Mask;                    /* Clear appropriate bit on port */
    }
  }
}

/*
** ===================================================================
**     Method      :  LED_VAL_SetBit (bean BitsIO)
**
**     Description :
**         This method sets (sets to one) the specified bit of the
**         output value.
**         [ It is the same as "PutBit(Bit,TRUE);" ]
**     Parameters  :
**         NAME       - DESCRIPTION
**         BitNum     - Number of the bit to set (0 to 3)
**     Returns     : Nothing
** ===================================================================
*/
void LED_VAL_SetBit(byte BitNum)
{
  byte Mask=LED_VAL_GetMsk(BitNum);    /* Temporary variable - bit mask */

  if (Mask) {                          /* Is bit mask correct? */
    PTC |= Mask;                       /* Set appropriate bit on port */
  }
}

/*
** ===================================================================
**     Method      :  LED_VAL_ClrBit (bean BitsIO)
**
**     Description :
**         This method clears (sets to zero) the specified bit
**         of the output value.
**         [ It is the same as "PutBit(Bit,FALSE);" ]
**     Parameters  :
**         NAME       - DESCRIPTION
**         BitNum     - Number of the bit to clear (0 to 3)
**     Returns     : Nothing
** ===================================================================
*/
void LED_VAL_ClrBit(byte BitNum)
{
  byte Mask=LED_VAL_GetMsk(BitNum);    /* Temporary variable - bit mask */

  if (Mask) {                          /* Is bit mask correct? */
    PTC &= ~Mask;                      /* Clear appropriate bit on port */
  }
}

/*
** ===================================================================
**     Method      :  LED_VAL_NegBit (bean BitsIO)
**
**     Description :
**         This method negates (invertes) the specified bit of the
**         output value.
**     Parameters  :
**         NAME       - DESCRIPTION
**         BitNum     - Number of the bit to invert (0 to 31)
**     Returns     : Nothing
** ===================================================================
*/
void LED_VAL_NegBit(byte BitNum)
{
  byte Mask=LED_VAL_GetMsk(BitNum);    /* Temporary variable - bit mask */

  if (Mask) {                          /* Is bit mask correct? */
    PTC ^= Mask;                       /* Negate appropriate bit on port */
  }
}

/*
** ===================================================================
**     Method      :  LED_VAL_GetDir (bean BitsIO)
**
**     Description :
**         This method returns direction of the bean.
**     Parameters  : None
**     Returns     :
**         ---        - Direction of the bean (always TRUE, Output only)
**                      FALSE = Input, TRUE = Output
** ===================================================================
*/
/*
bool LED_VAL_GetDir(void)

**  This method is implemented as a macro. See LED_VAL.h file.  **
*/

/*
** ###################################################################
**
**     This file was created by UNIS Processor Expert 03.23 for 
**     the Motorola HC08 series of microcontrollers.
**
** ###################################################################
*/
