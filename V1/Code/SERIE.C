/*
** ###################################################################
**
**     THIS BEAN MODULE IS GENERATED BY THE TOOL. DO NOT MODIFY IT.
**
**     Filename  : SERIE.C
**
**     Project   : CtrlCam
** 
**     Processor : MC68HC908GP32CFB
**
**     Beantype  : AsynchroSerial
**
**     Version   : Bean 02.216, Driver 01.43, CPU db: 2.89.000
**
**     Compiler  : Metrowerks HC08 C Compiler
**
**     Date/Time : 9/15/miИrcoles, 10:49
**
**     Abstract  :
**
**         This bean "AsynchroSerial" implements an asynchronous serial
**         communication. The bean supports different settings of 
**         parity, word width, stop-bit and communication speed,
**         user can select interrupt or polling handler.
**         Communication speed can be changed also in runtime.
**         The bean requires one on-chip asynchronous serial channel.
**
**     Settings  :
**
**         Serial channel              : SCI
**
**         Protocol
**             Init baud rate          : 9600baud
**             Width                   : 8 bits
**             Stop bits               : 1
**             Parity                  : none
**             Breaks                  : Disabled
**
**         Registers
**             Input buffer            : SCDR      [24]
**             Output buffer           : SCDR      [24]
**             Control register        : SCC1      [19]
**             Mode register           : SCC2      [20]
**             Baud setting reg.       : SCBR      [25]
**             Special register        : SCS1      [22]
**
**         Input interrupt
**             Vector name             : INT_SCIReceive
**
**         Output interrupt
**             Vector name             : INT_SCITransmit
**
**         Used pins                   : 
**             ----------------------------------------------------
**               Function | On package |    Name
**             ----------------------------------------------------
**                Input   |     10     |  PTE1_RxD
**                Output  |     9      |  PTE0_TxD
**             ----------------------------------------------------
**
**
**
**     Contents  :
**
**         RecvChar        - byte SERIE_RecvChar(SERIE_TComData *Chr);
**         SendChar        - byte SERIE_SendChar(SERIE_TComData Chr);
**         RecvBlock       - byte SERIE_RecvBlock(SERIE_TComData *Ptr,word Size,word *Rcv);
**         SendBlock       - byte SERIE_SendBlock(SERIE_TComData *Ptr,word Size,word *Snd);
**         ClearRxBuf      - byte SERIE_ClearRxBuf(void);
**         ClearTxBuf      - byte SERIE_ClearTxBuf(void);
**         CharsInRxBuf    - byte SERIE_CharsInRxBuf(word *Chr);
**         GetCharsInRxBuf - word SERIE_GetCharsInRxBuf(void);
**         GetCharsInTxBuf - word SERIE_GetCharsInTxBuf(void);
**         GetError        - byte SERIE_GetError(SERIE_TError *Err);
**
**
**     (c) Copyright UNIS, spol. s r.o. 1997-2002
**
**     UNIS, spol. s r.o.
**     Jundrovska 33
**     624 00 Brno
**     Czech Republic
**
**     http      : www.processorexpert.com
**     mail      : info@processorexpert.com
**
** ###################################################################
*/


/* MODULE SERIE. */

#pragma MESSAGE DISABLE C4002 /* WARNING C4002: Result not used is ignored */

#include "SERIE.h"
#include "LED_VAL.h"
#include "ENABLE_LED1.h"
#include "ENABLE_LED2.h"
#include "Timer.h"
#include "Flash.h"
#include "DERECHA.h"
#include "IZQUIERDA.h"
#include "ARRIBA.h"
#include "ABAJO.h"
#include "FOCOMAS.h"
#include "FOCOMENOS.h"
#include "ZOOMMAS.h"
#include "ZOOMMENOS.h"
#include "Seleccion.h"
#include "Teclado.h"
#include "Inhr2.h"
#include "Inhr3.h"
#include "Inhr4.h"
#include "Inhr5.h"
#include "Inhr6.h"
#include "Inhr7.h"
#include "Inhr8.h"
#include "Inhr9.h"
#include "JoistickAction.h"
#include "Events.h"


#define OVERRUN_ERR      1             /* Overrun error flag bit   */
#define FRAMING_ERR      2             /* Framing error flag bit   */
#define PARITY_ERR       4             /* Parity error flag bit    */
#define CHAR_IN_RX       8             /* Char is in RX buffer     */
#define FULL_TX          16            /* Full transmit buffer     */
#define RUNINT_FROM_TX   32            /* Interrupt is in progress */
#define FULL_RX          64            /* Full receive buffer      */
#define NOISE_ERR        128           /* Noise erorr flag bit     */
#define IDLE_ERR         256           /* Idle character flag bit  */
#define BREAK_ERR        512           /* Break detect             */

static word SerFlag;                   /* Flags for serial communication */
                                       /* Bits: 0 - OverRun error */
                                       /*       1 - Framing error */
                                       /*       2 - Parity error */
                                       /*       3 - Char in RX buffer */
                                       /*       4 - Full TX buffer */
                                       /*       5 - Running int from TX */
                                       /*       6 - Full RX buffer */
                                       /*       7 - Noise error */
                                       /*       8 - Idle character  */
                                       /*       9 - Break detected  */
                                       /*      10 - Unused */
static word ErrFlag;                   /* Error flags mirror of SerFlag */
static word InpLen;                    /* Length of input buffer's content */
static SERIE_TComData *InpPtrR;        /* Pointer for reading from input buffer */
static SERIE_TComData *InpPtrW;        /* Pointer for writing to input buffer */
static SERIE_TComData InpBuffer[10];   /* Input buffer for SCI commmunication */
static word OutLen;                    /* Length of output bufer's content */
static SERIE_TComData *OutPtrR;        /* Pointer for reading from output buffer */
static SERIE_TComData *OutPtrW;        /* Pointer for writing to output buffer */
static SERIE_TComData OutBuffer[10];   /* Output buffer for SCI commmunication */


/*
** ===================================================================
**     Method      :  HWEnDi (bean AsynchroSerial)
**
**     Description :
**         This method is internal. It is used by Processor Expert
**         only.
** ===================================================================
*/
static void HWEnDi(void)
{
    SCC1_ENSCI = 1;                    /* Enable device */
    SCC2_TE = 1;                       /* Enable transmitter */
    SCC2_RE = 1;                       /* Enable receiver */
    SCC2_SCRIE = 1;                    /* Enable recive interrupt */
    /* SCC3: ORIE=1,NEIE=1,FEIE=1,PEIE=1 */
    SCC3 |= 15;                        /* Enable error interrupts */
}


/*
** ===================================================================
**     Method      :  SERIE_RecvChar (bean AsynchroSerial)
**
**     Description :
**         If any data received, this method returns one character,
**         otherwise it returns error code (it does not wait for
**         data). This method is enabled only if the receiver
**         property is enabled.
**     Parameters  :
**         NAME            - DESCRIPTION
**       * Chr             - Pointer to received character
**     Returns     :
**         ---             - Error code, possible codes:
**                           ERR_OK - OK
**                           ERR_SPEED - This device does not work in
**                           the active speed mode
**                           ERR_RXEMPTY - No data in receiver
**                           ERR_OVERRUN - Overrun error is detected
**                           ERR_FRAMING - Framing error is detected
**                           ERR_PARITY - Parity error is detected
**                           ERR_BREAK - Break character is detected
**                           ERR_IDLE - Idle character is detected
**                           (this error is hardware specific).
** ===================================================================
*/
byte SERIE_RecvChar(SERIE_TComData *Chr)
{
  byte Result = ERR_OK;                /* Return error code */

  if(InpLen > 0) {                     /* Is number of received chars greater than 0? */
    EnterCritical();                   /* Save the PS register */
    InpLen--;                          /* Decrease number of received chars */
    *Chr = *(InpPtrR++);               /* Received char */
    if(InpPtrR >= InpBuffer + 10)      /* Is the pointer out of the receive buffer? */
      InpPtrR = InpBuffer;             /* Set pointer to the first item into the receive buffer */
    ExitCritical();                    /* Restore the PS register */
  }
  else {
    return ERR_RXEMPTY;                /* Receiver is empty */
  }
  if ((SerFlag & (OVERRUN_ERR|FRAMING_ERR|PARITY_ERR|NOISE_ERR|FULL_RX)) != 0) {
    if((SerFlag & OVERRUN_ERR) != 0)   /* Is the overrun error detected? */
      Result = ERR_OVERRUN;            /* If yes then set the overrun error flag */
    else if((SerFlag & PARITY_ERR) != 0) /* Is the parity error detected? */
      Result = ERR_PARITY;             /* If yes then set the parity error flag */
    else if((SerFlag & FRAMING_ERR) != 0) /* Is the framing error detected? */
      Result = ERR_FRAMING;            /* If yes then set the framing error flag */
    else if((SerFlag & FULL_RX) != 0)  /* Is the software overrun error detected? */
      Result = ERR_OVERRUN;            /* If yes then set the overrun error flag */
    else if((SerFlag & NOISE_ERR) != 0) /* Is the noise error detected? */
      Result = ERR_NOISE;              /* If yes then set the noise error flag */
  }
  SerFlag &= ~(OVERRUN_ERR|FRAMING_ERR|PARITY_ERR|NOISE_ERR|IDLE_ERR|FULL_RX); /* Clear all errors in the status variable */
  return Result;                       /* Return error code */
}

/*
** ===================================================================
**     Method      :  SERIE_SendChar (bean AsynchroSerial)
**
**     Description :
**         Send one character to the channel. This method is
**         available only if the transmitter property is enabled.
**     Parameters  :
**         NAME            - DESCRIPTION
**         Chr             - Character to send
**     Returns     :
**         ---             - Error code, possible codes:
**                           ERR_OK - OK
**                           ERR_SPEED - This device does not work in
**                           the active speed mode
**                           ERR_TXFULL - Transmitter is full
** ===================================================================
*/
byte SERIE_SendChar(SERIE_TComData Chr)
{
  if(OutLen == 10)                     /* Is number of chars in buffer is the same as a size of the transmit buffer */
    return ERR_TXFULL;                 /* If yes then error */
  EnterCritical();                     /* Save the PS register */
  OutLen++;                            /* Increase number of bytes in the transmit buffer */
  *(OutPtrW++) = Chr;                  /* Store char to buffer */
  if(OutPtrW >= OutBuffer + 10)        /* Is the pointer out of the transmit buffer */
    OutPtrW = OutBuffer;               /* Set pointer to first item in the transmit buffer */
  SCC2_SCTIE = 1;                      /* Enable transmit interrupt */
  ExitCritical();                      /* Restore the PS register */
  return ERR_OK;                       /* OK */
}

/*
** ===================================================================
**     Method      :  SERIE_RecvBlock (bean AsynchroSerial)
**
**     Description :
**         If any data received, this method returns the block ofthe
**         data and its lenght (and incidental error), otherwise it
**         returns error code (it does not wait for data).
**         This method is available only if non-zero lenght of the
**         input buffer is defined and the receiver property is
**         enabled.
**     Parameters  :
**         NAME            - DESCRIPTION
**       * Ptr             - Pointer to the block of received data
**         Size            - Size of the block
**       * Rcv             - Pointer to real number of the received
**                           data
**     Returns     :
**         ---             - Error code, possible codes:
**                           ERR_OK - OK
**                           ERR_SPEED - This device does not work in
**                           the active speed mode
**                           ERR_RXEMPTY - No data in receiver
**                           ERR_OVERRUN - Overrun error is detected
**                           ERR_FRAMING - Framing error is detected
**                           ERR_PARITY - Parity error is detected
**                           ERR_BREAK - Break character is detected
**                           ERR_IDLE - Idle character is detected
**                           (this error is hardware specific).
** ===================================================================
*/
byte SERIE_RecvBlock(SERIE_TComData *Ptr, word Size, word *Rcv)
{
  word count;                          /* Number of received chars */
  byte result = ERR_OK;                /* Last error */

  if(!Size)                            /* Is size not greater than 0 */
    return ERR_OK;                     /* If yes then OK */
  for(count = 0; count < Size; count++) {
    result = SERIE_RecvChar(Ptr++);
    if(result != ERR_OK) {             /* Receiving given number of chars */
      *Rcv = count;                    /* Return number of received chars */
      return result;                   /* Return last error */
    }
  }
  *Rcv = count;                        /* Return number of received chars */
  return result;                       /* OK */
}

/*
** ===================================================================
**     Method      :  SERIE_SendBlock (bean AsynchroSerial)
**
**     Description :
**         Send a block of characters to the channel.
**         This method is available only if non-zero lenght of the
**         output buffer is defined and the transmitter property is
**         enabled.
**     Parameters  :
**         NAME            - DESCRIPTION
**       * Ptr             - Pointer to the block of data to send
**         Size            - Size of the block
**       * Snd             - Pointer to number of data that are sent
**                           (moved to buffer)
**     Returns     :
**         ---             - Error code, possible codes:
**                           ERR_OK - OK
**                           ERR_SPEED - This device does not work in
**                           the active speed mode
**                           ERR_TXFULL - It was not possible to send
**                           requested number of bytes
** ===================================================================
*/
byte SERIE_SendBlock(SERIE_TComData *Ptr, word Size, word *Snd)
{
  word count;                          /* Number of sent chars */
  byte result = ERR_OK;                /* Last error */

  if(!Size)                            /* Test variable Size on zero */
    return ERR_OK;                     /* If zero then OK */
  for(count = 0; count < Size; count++) {
    result = SERIE_SendChar(*Ptr++);
    if(result != ERR_OK) {             /* Sending given number of chars */
      *Snd = count;                    /* Return number of sent chars */
      return result;                   /* Return last error */
    }
  }
  *Snd = count;                        /* Return number of sended chars */
  return result;                       /* OK */
}

/*
** ===================================================================
**     Method      :  SERIE_ClearRxBuf (bean AsynchroSerial)
**
**     Description :
**         Clear receive buffer.
**         This method is available only if non-zero lenght of the
**         input buffer is defined and the receiver property is
**         enabled.
**     Parameters  : None
**     Returns     :
**         ---             - Error code, possible codes:
**                           ERR_OK - OK
**                           ERR_SPEED - This device does not work in
**                           the active speed mode
** ===================================================================
*/
byte SERIE_ClearRxBuf(void)
{
  EnterCritical();                     /* Save the PS register */
  InpLen = 0;                          /* Set number of chars in the transmit buffer to 0 */
  InpPtrR = InpPtrW = InpBuffer;       /* Set pointers on the first item in the transmit buffer */
  ExitCritical();                      /* Restore the PS register */
  return ERR_OK;                       /* OK */
}

/*
** ===================================================================
**     Method      :  SERIE_ClearTxBuf (bean AsynchroSerial)
**
**     Description :
**         Clear transmit buffer.
**         This method is available only if non-zero lenght of the
**         output buffer is defined and the receiver property is
**         enabled.
**     Parameters  : None
**     Returns     :
**         ---             - Error code, possible codes:
**                           ERR_OK - OK
**                           ERR_SPEED - This device does not work in
**                           the active speed mode
** ===================================================================
*/
byte SERIE_ClearTxBuf(void)
{
  EnterCritical();                     /* Save the PS register */
  OutLen = 0;                          /* Set number of chars in the receive buffer to 0 */
  OutPtrR = OutPtrW = OutBuffer;       /* Set pointers on the first item in the receive buffer */
  ExitCritical();                      /* Restore the PS register */
  return ERR_OK;                       /* OK */
}

/*
** ===================================================================
**     Method      :  SERIE_CharsInRxBuf (bean AsynchroSerial)
**
**     Description :
**         Return number of characters in the input buffer. This
**         method is available only if the receiver property is
**         enabled.
**         [deprecated method]
**     Parameters  :
**         NAME            - DESCRIPTION
**       * Chr             - Pointer to number of characters in the
**                           input buffer
**     Returns     :
**         ---             - Error code, possible codes:
**                           ERR_OK - OK
**                           ERR_SPEED - This device does not work in
**                           the active speed mode
** ===================================================================
*/
byte SERIE_CharsInRxBuf(word *Chr)
{
  *Chr = InpLen;                       /* Return number of chars in receive buffer */
  return ERR_OK;                       /* OK */
}

/*
** ===================================================================
**     Method      :  SERIE_GetCharsInRxBuf (bean AsynchroSerial)
**
**     Description :
**         Return number of characters in the input buffer. This
**         method is available only if the receiver property is
**         enabled.
**     Parameters  : None
**     Returns     :
**         ---             - Number of characters in the input
**                           buffer.
** ===================================================================
*/
word SERIE_GetCharsInRxBuf(void)
{
  return InpLen;                       /* Return number of chars in receive buffer */
}

/*
** ===================================================================
**     Method      :  SERIE_GetCharsInTxBuf (bean AsynchroSerial)
**
**     Description :
**         Return number of characters in the output buffer. This
**         method is available only if the transmitter property is
**         enabled.
**     Parameters  : None
**     Returns     :
**         ---             - Number of characters in the output
**                           buffer.
** ===================================================================
*/
word SERIE_GetCharsInTxBuf(void)
{
  return OutLen;                       /* Return number of chars in the transmitter buffer */
}

/*
** ===================================================================
**     Method      :  SERIE_GetError (bean AsynchroSerial)
**
**     Description :
**         Return a set of errors on the channel (errors that cannot
**         be returned in given methods). The errors accumulate in a
**         set; after calling [GetError] this set is returned and
**         cleared.
**     Parameters  :
**         NAME            - DESCRIPTION
**       * Err             - Pointer to returned set of errors
**     Returns     :
**         ---             - Error code (if GetError did not succeed),
**                           possible codes:
**                           ERR_OK - OK
**                           ERR_SPEED - This device does not work in
**                           the active speed mode
** ===================================================================
*/
byte SERIE_GetError(SERIE_TError *Err)
{
  EnterCritical();                     /* Save the PS register */
  if(SCS1_IDLE) {                      /* if IDLE character received */
    ErrFlag |= IDLE_ERR;
    SCDR;                              /* Dummy read of SCIxD registers - clear the IDLE bit */
  }
  Err->err = 0;
  Err->errName.OverRun = ((ErrFlag & OVERRUN_ERR) != 0); /* Overrun error */
  Err->errName.Framing = ((ErrFlag & FRAMING_ERR ) != 0); /* Framing error */
  Err->errName.Parity = ((ErrFlag & PARITY_ERR) != 0); /* Parity error */
  Err->errName.RxBufOvf = ((ErrFlag & FULL_RX) != 0); /* Buffer overflow */
  Err->errName.Noise = ((ErrFlag & NOISE_ERR) != 0); /* Noise error */
  Err->errName.Idle = ((ErrFlag & IDLE_ERR) != 0); /* Idle character */
  ErrFlag = 0;                         /* Clear error flags */
  ExitCritical();                      /* Restore the PS register */
  return ERR_OK;                       /* OK */
}

/*
** ===================================================================
**     Method      :  SERIE_InterruptRx (bean AsynchroSerial)
**
**     Description :
**         This method is internal. It is used by Processor Expert
**         only.
** ===================================================================
*/
#define ON_ERROR      1
#define ON_FULL_RX    2
#define ON_RX_CHAR    4
#define ON_IDLE_CHAR  8
__interrupt void SERIE_InterruptRx(void)
{
  SERIE_TComData Data;                 /* Temporary variable for data */
  byte OnFlags = 0;                    /* Temporary variable for flags */

  if(SCS1_IDLE) {                      /* if IDLE character received */
    SerFlag |= IDLE_ERR;
    ErrFlag |= IDLE_ERR;
  }
  SCS1;                                /* Dummy read of SCS1 register - clear the SCRF bit */
  Data = SCDR;                         /* Read data from the receiver */
    if(InpLen < 10) {                  /* Is number of bytes in the receive buffer lower than size of buffer? */
      InpLen++;                        /* Increse number of chars in the receive buffer */
      *(InpPtrW++) = Data;             /* Save received char to the receive buffer */
      if(InpPtrW >= InpBuffer + 10)    /* Is the pointer out of the receive buffer? */
        InpPtrW = InpBuffer;           /* Set pointer on the first item into the receive buffer */
      OnFlags |= ON_RX_CHAR;           /* Set flag "OnRXChar" */
      if(InpLen== 10)                  /* Is number of bytes in the receive buffer equal as a size of buffer? */
        OnFlags |= ON_FULL_RX;         /* If yes then set flag "OnFullRxBuff" */
    }
    else {
      SerFlag |= FULL_RX;              /* If yes then set flag buffer overflow */
      ErrFlag |= FULL_RX;
      OnFlags |= ON_ERROR;             /* Set flag "OnError" */
    }
    if(OnFlags & ON_ERROR) {           /* Was error flag detect? */
      SERIE_OnError();                 /* If yes then invoke user event */
    }
    else {
      if(OnFlags & ON_RX_CHAR) {       /* Is OnRxChar flag set? */
        SERIE_OnRxChar();              /* If yes then invoke user event */
      }
      if(OnFlags & ON_FULL_RX) {       /* Is OnFullRxBuf flag set? */
        SERIE_OnFullRxBuf();           /* If yes then invoke user event */
      }
    }
}

/*
** ===================================================================
**     Method      :  SERIE_InterruptTx (bean AsynchroSerial)
**
**     Description :
**         This method is internal. It is used by Processor Expert
**         only.
** ===================================================================
*/
#define ON_FREE_TX  1
#define ON_TX_CHAR  2
__interrupt void SERIE_InterruptTx(void)
{
  byte OnFlags = 0;                    /* Temporary variable for flags */

  if(SerFlag & RUNINT_FROM_TX)         /* Is flag "running int from TX" set? */
    OnFlags |= ON_TX_CHAR;             /* Set flag "OnTxChar" */
  SerFlag &= ~RUNINT_FROM_TX;          /* Reset flag "running int from TX" */
  if(OutLen) {                         /* Is number of bytes in the transmit buffer greater then 0? */
    OutLen--;                          /* Decrease number of chars in the transmit buffer */
    SerFlag |= RUNINT_FROM_TX;         /* Set flag "running int from TX"? */
    SCS1;                              /* Reset interrupt request flag */
    SCDR = (byte)*(OutPtrR++);         /* Store char to transmitter register */
    if(OutPtrR >= OutBuffer + 10)      /* Is the pointer out of the transmit buffer? */
      OutPtrR = OutBuffer;             /* Set pointer on the first item into the transmit buffer */
  }
  else {
    OnFlags |= ON_FREE_TX;             /* Set flag "OnFreeTxBuf" */
    SCC2_SCTIE = 0;                    /* Disable transmit interrupt */
  }
    if(OnFlags & ON_TX_CHAR) {         /* Is flag "OnTxChar" set? */
      SERIE_OnTxChar();                /* If yes then invoke user event */
    }
    if(OnFlags & ON_FREE_TX) {         /* Is flag "OnFreeTxBuf" set? */
      SERIE_OnFreeTxBuf();             /* If yes then invoke user event */
    }
}

/*
** ===================================================================
**     Method      :  SERIE_InterruptError (bean AsynchroSerial)
**
**     Description :
**         This method is internal. It is used by Processor Expert
**         only.
** ===================================================================
*/
__interrupt void SERIE_InterruptError(void)
{
  byte OnFlags = 0;                    /* Temporary variable for flags */
  if(SCS1_PE)
    OnFlags |= PARITY_ERR;
  if(SCS1_OR)
    OnFlags |= OVERRUN_ERR;
  if (SCS1_FE)
    OnFlags |= FRAMING_ERR;
  if(SCS1_NF)
    OnFlags |= NOISE_ERR;
  if(SCS1_IDLE)                        /* if IDLE character received */
    OnFlags |= IDLE_ERR;
  SerFlag |= OnFlags;                  /* Copy flags status to SerFlag status variable */
  ErrFlag |= OnFlags;                  /* Copy flags status to ErrFlag status variable */
  SCDR;                                /* Dummy read of data register - clear error bits */
  if(SerFlag & (OVERRUN_ERR|FRAMING_ERR|PARITY_ERR|NOISE_ERR|IDLE_ERR)) { /* Was any error set? */
      SERIE_OnError();                 /* If yes then invoke user event */
  }
}

/*
** ===================================================================
**     Method      :  SERIE_Init (bean AsynchroSerial)
**
**     Description :
**         This method is internal. It is used by Processor Expert
**         only.
** ===================================================================
*/
void SERIE_Init(void)
{
  SerFlag = 0;                         /* Reset flags */
  SCC1 = 0;
  InpLen = 0;                          /* No char in the receive buffer */
  InpPtrW = InpPtrR = InpBuffer;       /* Set pointer on the first item in the receive buffer */
  OutLen = 0;                          /* No char in the transmit buffer */
  OutPtrW = OutPtrR = OutBuffer;       /* Set pointer on the first item in the transmit buffer */
  /* SCC3: R8=0,T8=0,??=0,??=0,ORIE=0,NEIE=0,FEIE=0,PEIE=0 */
  SCC3 = 0;                            /* Disable error interrupts */
  SCBR_SCP = 0;                        /* Set prescaler bits */
  SCBR_SCR = 3;                        /* Set divisor bits */
  HWEnDi();                            /* Enable/disable device according to status flags */
}


/* END SERIE. */


/*
** ###################################################################
**
**     This file was created by UNIS Processor Expert 03.23 for 
**     the Motorola HC08 series of microcontrollers.
**
** ###################################################################
*/
